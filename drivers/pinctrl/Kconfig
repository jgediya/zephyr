## drivers/pinctrl/Kconfig
```kconfig
# Copyright (c) 2021 Nordic Semiconductor ASA
# SPDX-License-Identifier: Apache-2.0

menuconfig PINCTRL
	bool "Enable pin controller drivers"

if PINCTRL

config PINCTRL_STORE_REG
	bool
	help
	  This option must be selected by drivers that require access to the device
	  register address. This can happen, for example, if certain pin control
	  actions are device dependent or require access to device specific
	  registers

config PINCTRL_NON_STATIC
	bool
	help
	  This option can be selected if the pin control configuration defined by
	  a driver has to be accessed externally. This can happen, for example, when
	  dynamic pin control is enabled or in testing environments.

config PINCTRL_TEST_STORE_REG
	bool "Store register address (testing)"
	select PINCTRL_STORE_REG
	help
	  This option should be selected by unit tests that want to store the
	  register address of devices.

config PINCTRL_TEST_NON_STATIC
	bool "Enable access to pin control configuration (testing)"
	select PINCTRL_NON_STATIC
	help
	  This option should be selected by unit tests that need to access the pin
	  control configuration defined in a device driver.

config PINCTRL_DYNAMIC
	bool "Enable dynamic configuration of pins"
	select PINCTRL_NON_STATIC
	help
	  When this option is enabled pin control configuration can be changed at
	  runtime. This can be useful, for example, to change the pins assigned to a
	  peripheral at early boot stages depending on a certain input.

source "drivers/pinctrl/Kconfig.nrf"
source "drivers/pinctrl/Kconfig.stm32"

config PINCTRL_NXP_MCUX
	bool "Pin controller driver for NXP Kinetis MCUs"
	depends on SOC_FAMILY_KINETIS
	default y
	help
	  Enable pin controller driver for NXP Kinetis MCUs

config PINCTRL_NXP_MCUX_LPC
	bool "Pin controller driver for NXP LPC MCUs"
	depends on SOC_FAMILY_LPC
	default y
	help
	  Enable pin controller driver for NXP LPC MCUs

endif # PINCTRL
```

## drivers/pinctrl/Kconfig.stm32
```kconfig
# Copyright (c) 2021 Nordic Semiconductor ASA
# SPDX-License-Identifier: Apache-2.0

config PINCTRL_STM32
	bool "Pin controller driver for STM32 MCUs"
	depends on SOC_FAMILY_STM32
	select PINCTRL_STORE_REG if SOC_SERIES_STM32F1X
	default y
	help
	  Enable pin controller driver for STM32 MCUs
```

## dts/bindings/pinctrl/nordic,nrf-pinctrl.yaml
```yaml
# Copyright (c) 2021 Nordic Semiconductor ASA
# SPDX-License-Identifier: Apache-2.0

description: |
    nRF pin controller

compatible: "nordic,nrf-pinctrl"

include:
    - name: base.yaml
    - name: pincfg-node-group.yaml
      child-binding:
        child-binding:
          property-allowlist:
            - bias-disable
            - bias-pull-down
            - bias-pull-up
            - low-power-enable

child-binding:
  description: |
    nRF pin controller pin configuration nodes. Each node is composed by one or
    more groups, each defining the configuration for a set of pins.

  child-binding:
    description: |
      nRF pin controller pin configuration group. Each group contains a list of
      pins sharing the same set of properties. Example:

      uart0_default: uart0_default {
        /* group 1 (name is arbitrary) */
        pins1 {
          /* configure P0.1 as UART_TX and P0.2 as UART_RTS */
          pins = <NRF_PIN(0, 1, UART_TX)>, <NRF_PIN(0, 2, UART_RTS)>;
        };
        /* group 2 (name is arbitrary) */
        pins2 {
          /* configure P0.3 as UART_RX and P0.4 as UART_CTS */
          pins = <NRF_PIN(0, 3, UART_RX)>, <NRF_PIN(0, 4, UART_CTS)>;
          /* both P0.3 and P0.4 are configured with pull-up */
          bias-pull-up;
        };
      };

      The list of supported standard properties:

      - bias-disable: Disable pull-up/down (default behavior, not required).
      - bias-pull-up: Enable pull-up resistor.
      - bias-pull-down: Enable pull-down resistor.
      - low-power-enable: Configure pin as an input with input buffer
        disconnected.

      Note that bias options are mutually exclusive.

    properties:
      pins:
        required: true
        type: array
        description: |
          An array of pins sharing the same group properties. The pins should
          be defined using the NRF_PIN utility macro that encodes the port,
          pin and function.

      drive-mode:
        type: int
        default: 0
        description: |
          Pin output drive mode. Available drive modes are pre-defined in
          nrf-pinctrl.h. Note that extra modes may not be available on certain
          devices. Defaults to standard mode for 0 and 1 (NRF_DRIVE_S0S1).
```

## tests/drivers/pinctrl/nrf/testcase.yaml
```yaml
tests:
  drivers.pinctrl.nrf:
    tags: drivers pinctrl
    platform_allow: nrf52840dk_nrf52840
```
